## CMakeLists.txt
```
cmake_minimum_required(VERSION 3.20.0)

# Auto-load board-specific overlay if it exists
set(BOARD_OVERLAY ${CMAKE_CURRENT_SOURCE_DIR}/overlays/${BOARD}.overlay)
if(EXISTS ${BOARD_OVERLAY})
    set(DTC_OVERLAY_FILE ${BOARD_OVERLAY})
endif()

# Auto-load board-specific conf if it exists
set(BOARD_CONF ${CMAKE_CURRENT_SOURCE_DIR}/config/${BOARD}.conf)
if(EXISTS ${BOARD_CONF})
    set(CONF_FILE ${CMAKE_CURRENT_SOURCE_DIR}/prj.conf ${BOARD_CONF})
endif()

find_package(Zephyr REQUIRED HINTS $ENV{ZEPHYR_BASE})
project(securenode VERSION 1.0.0)

target_include_directories(app PRIVATE include)
target_sources(app PRIVATE src/main.c)
```

## Kconfig
```
mainmenu "SecureNode Configuration"

config SECURENODE_BLINK_MS
    int "LED blink interval (ms)"
    default 500
    help
      Interval between LED toggles in milliseconds.

config SECURENODE_LOG_LEVEL
    int "Log level (0=OFF 1=ERR 2=WRN 3=INF 4=DBG)"
    default 3
    range 0 4

source "Kconfig.zephyr"
```

## prj.conf
```kconfig
# ── Core ─────────────────────────────────────────────────────────────────────
CONFIG_SERIAL=y
CONFIG_CONSOLE=y
CONFIG_UART_CONSOLE=y
CONFIG_PRINTK=y

# ── Logging ──────────────────────────────────────────────────────────────────
CONFIG_LOG=y
CONFIG_LOG_DEFAULT_LEVEL=3
CONFIG_SECURENODE_LOG_LEVEL=3

# ── GPIO ─────────────────────────────────────────────────────────────────────
CONFIG_GPIO=y

# ── App ──────────────────────────────────────────────────────────────────────
CONFIG_SECURENODE_BLINK_MS=500
```

## src/main.c
```c
/*
 * SecureNode — Multi-board Zephyr template
 * Supports: STM32F407 Discovery, ESP32 DevKitC
 */
#include <zephyr/kernel.h>
#include <zephyr/device.h>
#include <zephyr/drivers/gpio.h>
#include <zephyr/logging/log.h>
#include "securenode.h"

LOG_MODULE_REGISTER(main, CONFIG_SECURENODE_LOG_LEVEL);

#define LED0_NODE DT_ALIAS(led0)
static const struct gpio_dt_spec led = GPIO_DT_SPEC_GET(LED0_NODE, gpios);

int main(void)
{
    int ret;

    LOG_INF("SecureNode starting on %s", CONFIG_BOARD);
    LOG_INF("Zephyr version: %s", KERNEL_VERSION_STRING);

    if (!gpio_is_ready_dt(&led)) {
        LOG_ERR("LED device not ready");
        return -ENODEV;
    }

    ret = gpio_pin_configure_dt(&led, GPIO_OUTPUT_ACTIVE);
    if (ret < 0) {
        LOG_ERR("Failed to configure LED: %d", ret);
        return ret;
    }

    LOG_INF("SecureNode ready. Blinking LED...");

    while (1) {
        gpio_pin_toggle_dt(&led);
        LOG_DBG("LED toggled");
        k_sleep(K_MSEC(CONFIG_SECURENODE_BLINK_MS));
    }

    return 0;
}
```

## include/securenode.h
```c
#ifndef SECURENODE_H
#define SECURENODE_H

#include <zephyr/kernel.h>

#define SECURENODE_VERSION_MAJOR 1
#define SECURENODE_VERSION_MINOR 0
#define SECURENODE_VERSION_PATCH 0

#endif /* SECURENODE_H */
```
